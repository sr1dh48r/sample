## CMakeLists.txt
```
#
# Copyright (c) 2022 Nordic Semiconductor ASA
#
# SPDX-License-Identifier: LicenseRef-Nordic-5-Clause
#

cmake_minimum_required(VERSION 3.20.0)

find_package(Zephyr REQUIRED HINTS $ENV{ZEPHYR_BASE})
project(hello_world)

# TODO: Remove this hack
target_include_directories(mbedcrypto_common
        INTERFACE
        ${CMAKE_SOURCE_DIR}
        ${ZEPHYR_BASE}/subsys/net/ip
		${HOSTAP_BASE}/
		${HOSTAP_BASE}/
		${COMMON_SRC_BASE}/utils
		${COMMON_SRC_BASE}/drivers
		${HOSTAP_BASE}/src
)

target_sources(app PRIVATE
	src/main.c
	${ZEPHYR_BASE}/samples/net/zperf/src/shell_utils.c
	${ZEPHYR_BASE}/samples/net/zperf/src/zperf_session.c
	${ZEPHYR_BASE}/samples/net/zperf/src/zperf_shell.c
	${ZEPHYR_BASE}/samples/net/zperf/src/zperf_udp_receiver.c
	${ZEPHYR_BASE}/samples/net/zperf/src/zperf_udp_uploader.c
	${ZEPHYR_BASE}/samples/net/zperf/src/zperf_tcp_receiver.c
	${ZEPHYR_BASE}/samples/net/zperf/src/zperf_tcp_uploader.c
)
```

## prj.conf
```kconfig
CONFIG_WPA_SUPP=y
CONFIG_WIFI_NRF=y

CONFIG_EARLY_CONSOLE=y

# Generic networking options
CONFIG_NETWORKING=y
CONFIG_NET_IPV4=y
#CONFIG_NET_LOOPBACK=y
#CONFIG_NET_DRIVERS=y
# Need full fledged support
CONFIG_NEWLIB_LIBC=y
CONFIG_NET_IPV6=y
CONFIG_NET_UDP=y

CONFIG_NET_SOCKETS=y
CONFIG_NET_SOCKETS_POSIX_NAMES=y
CONFIG_NET_SOCKETS_POLL_MAX=4
CONFIG_NET_SOCKETS_PACKET=y

CONFIG_COAP=y
#CONFIG_DEBUG=y

# Kernel options
CONFIG_ENTROPY_GENERATOR=y

# Logging
CONFIG_PRINTK=y
CONFIG_NET_LOG=y
CONFIG_SHELL=y
CONFIG_SHELL_GETOPT=y
CONFIG_DEVICE_SHELL=y
CONFIG_POSIX_CLOCK=y
CONFIG_DATE_SHELL=y

# Debugging
CONFIG_STACK_SENTINEL=y
CONFIG_DEBUG_COREDUMP=y
CONFIG_DEBUG_COREDUMP_BACKEND_LOGGING=y

# Network Shell
CONFIG_NET_SHELL=y

# Wi-Fi
# Need to manually disable CONFIG_NET_L2_WIFI_MGMT in subsys/net/l2/Kconfig: 117
# and enable -DCONFIG_WPA_S_ZEPHYR_L2_WIFI_MGMT in CMakelists.txt
CONFIG_NET_L2_WIFI_SHELL=y
CONFIG_NET_MGMT_EVENT_INFO=y

# Security (use SW crypto for now)
CONFIG_CRYPTO=n
# CONFIG_CRYPTO_MBEDTLS_SHIM=y
# CONFIG_MBEDTLS_HEAP_SIZE=2048

CONFIG_NET_CONFIG_SETTINGS=y
CONFIG_NET_CONFIG_NEED_IPV6=y
CONFIG_NET_CONFIG_MY_IPV6_ADDR="2001:db8::2"
CONFIG_NET_CONFIG_PEER_IPV6_ADDR="2001:db8::1"

CONFIG_HEAP_MEM_POOL_SIZE=2048
CONFIG_MAIN_STACK_SIZE=4096

##### DRIVER 

# POSIX
#CONFIG_POSIX_API=y
#CONFIG_POSIX_CLOCK=y

# QSPI
CONFIG_FLASH=y
CONFIG_NRFX_QSPI=y
CONFIG_HEAP_MEM_POOL_SIZE=200000

# SPIM
CONFIG_NRFX_SPIM=y
CONFIG_NRFX_SPIM3=y
CONFIG_NRFX_SPIM4=y

# WIFI

CONFIG_NETWORKING=y
CONFIG_TEST_RANDOM_GENERATOR=y

CONFIG_NET_TX_STACK_SIZE=2048
CONFIG_NET_RX_STACK_SIZE=2048

CONFIG_NET_IPV4=y
CONFIG_NET_IPV6=n

CONFIG_NET_LOG=y
CONFIG_INIT_STACKS=y

CONFIG_NET_SHELL=y

CONFIG_NET_STATISTICS=y
CONFIG_NET_STATISTICS_PERIODIC_OUTPUT=n

CONFIG_WIFI=y
CONFIG_WIFI_LOG_LEVEL_ERR=y
CONFIG_NET_L2_WIFI_SHELL=y

# SDK 1.6.1
# CONFIG_NET_TCP=y      # error on warnings
CONFIG_USE_SEGGER_RTT=n # compilation error

# Ethernet
CONFIG_NETWORKING=y
CONFIG_NET_UDP=y
CONFIG_NET_TCP=y
CONFIG_NET_IPV6=y
CONFIG_NET_IPV4=y
CONFIG_NET_DHCPV4=y
CONFIG_DNS_RESOLVER=y

CONFIG_ENTROPY_GENERATOR=y
CONFIG_TEST_RANDOM_GENERATOR=y
CONFIG_INIT_STACKS=y

CONFIG_NET_LOG=y
CONFIG_LOG=y

CONFIG_NET_STATISTICS=y

CONFIG_NET_PKT_RX_COUNT=32
CONFIG_NET_PKT_TX_COUNT=32
CONFIG_NET_BUF_RX_COUNT=64
CONFIG_NET_BUF_TX_COUNT=64

CONFIG_NET_IF_UNICAST_IPV6_ADDR_COUNT=3
CONFIG_NET_IF_MCAST_IPV6_ADDR_COUNT=4
CONFIG_NET_MAX_CONTEXTS=10

CONFIG_NET_SHELL=y

CONFIG_NET_CONFIG_SETTINGS=y
CONFIG_NET_CONFIG_NEED_IPV6=y
CONFIG_NET_CONFIG_NEED_IPV4=y

CONFIG_NET_L2_ETHERNET=y

CONFIG_ETH_NATIVE_POSIX=y
CONFIG_ETH_NATIVE_POSIX_RANDOM_MAC=y
#CONFIG_ETH_NATIVE_POSIX_MAC_ADDR="00:00:5e:00:53:2a"
CONFIG_DEBUG_COREDUMP_MEMORY_DUMP_MIN=y
CONFIG_NET_BUF_DATA_SIZE=1200
CONFIG_MBEDTLS=y
CONFIG_NORDIC_SECURITY_BACKEND=y
CONFIG_HARDWARE_DEVICE_CS_GENERATOR=y

# TODO: We need to get it working without a hacked configuration file
CONFIG_GENERATE_MBEDTLS_CFG_FILE=n
CONFIG_MBEDTLS_PSA_CRYPTO_EXTERNAL_RNG=n
# Need this for CTR_DBRG and ENTROPY
CONFIG_MBEDTLS_CFG_FILE="src/nrf-config.h"
CONFIG_MBEDTLS_USER_CONFIG_FILE="src/nrf-config-user.h"
# To fix Kconfig MD5 warning
CONFIG_NET_TCP_ISN_RFC6528=n
CONFIG_WPA_SUPP_DEBUG_LEVEL="EXCESSIVE"
# zperf
CONFIG_NET_CONTEXT_SYNC_RECV=y
CONFIG_SHELL_CMDS_RESIZE=n
CONFIG_SHELL_STACK_SIZE=4096
CONFIG_SYSTEM_WORKQUEUE_STACK_SIZE=2048
```

## src/main.c
```c
/*
 * Copyright (c) 2012-2014 Wind River Systems, Inc.
 *
 * SPDX-License-Identifier: Apache-2.0
 */

#include <zephyr.h>
#include <sys/printk.h>
#include "common/defs.h"

void main(void)
{
	int i = 0;
	int key_mgmt = 0;
	printk("Hello World! %s\n", CONFIG_BOARD);

	sleep(10);

	zephyr_supp_add_network();
	zephyr_supp_set_ssid(0, "\"NORDIC-GUEST\"");
	zephyr_supp_set_psk(0, "\"BillionBluetooth\"");
	key_mgmt = WPA_KEY_MGMT_NONE|WPA_KEY_MGMT_PSK|WPA_KEY_MGMT_WPA_NONE;
	zephyr_supp_set_key_mgmt(0, key_mgmt);
	zephyr_supp_enable_network(0);	
}
```
